## boards/shields/corne_xiao_v2/Kconfig.defconfig
```kconfig
if SHIELD_CORNE_XIAO_V2_LEFT

config ZMK_KEYBOARD_NAME
    default "Kriz's KBD"

config ZMK_SPLIT_ROLE_CENTRAL
    default y

config BT_MAX_CONN
    default 6

config BT_MAX_PAIRED
    default 6

endif

if SHIELD_CORNE_XIAO_V2_LEFT || SHIELD_CORNE_XIAO_V2_RIGHT

config ZMK_SPLIT
    default y

config ZMK_POINTING
    default y

endif

if BOARD_XIAO_BLE && SHIELD_CORNE_XIAO_V2_RIGHT

config I2C
    default y

endif
```

## config/west.yml
```yaml
manifest:
  remotes:
    - name: zmkfirmware
      url-base: https://github.com/zmkfirmware
    - name: caksoylar
      url-base: https://github.com/caksoylar
    - name: petejohanson
      url-base: https://github.com/petejohanson
  projects:
    - name: zmk
      remote: zmkfirmware
      revision: v0.3
      import: app/west.yml
    - name: zmk-rgbled-widget
      remote: caksoylar
      revision: v0.3
    - name: cirque-input-module
      remote: petejohanson
      revision: 0de55f36bc720b5be3d8880dc856d4d78baf5214
  self:
    path: config
```
