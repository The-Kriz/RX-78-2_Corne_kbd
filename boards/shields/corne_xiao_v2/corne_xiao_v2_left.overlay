#include "corne_xiao_v2.dtsi"

&kscan0 {
    col-gpios
        = <&gpio0 16 GPIO_ACTIVE_HIGH>
        , <&xiao_d 10 GPIO_ACTIVE_HIGH>
        , <&xiao_d 3 GPIO_ACTIVE_HIGH>
        , <&xiao_d 8 GPIO_ACTIVE_HIGH>
        , <&xiao_d 6 GPIO_ACTIVE_HIGH>
        , <&xiao_d 7 GPIO_ACTIVE_HIGH>
        ;
};

&left_encoder {
    status = "okay";
};

// Enable input-split listener on central to receive trackpad events from right half
&input_split_right0 { status = "okay"; };
&input_listener_right0 { status = "okay"; };